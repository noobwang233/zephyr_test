## CMakeLists.txt
```
# SPDX-License-Identifier: Apache-2.0

cmake_minimum_required(VERSION 3.20.0)

find_package(Zephyr REQUIRED HINTS $ENV{ZEPHYR_BASE})
project(my-app)

target_sources(app PRIVATE src/main.c src/thread_monitor.c)
```

## prj.conf
```kconfig
# main 线程的栈大小
CONFIG_MAIN_STACK_SIZE=2048
# 启用 printk, 轻量级，实时性更好，不依赖 c 库
CONFIG_PRINTK=y
# 启用线程名，供调试使用
CONFIG_THREAD_NAME=y
# 启用启用线程监控功能
CONFIG_THREAD_MONITOR=y
# 启用线程栈使用查询接口
CONFIG_THREAD_STACK_INFO=y
# 降低代码优化，方便调试
CONFIG_NO_OPTIMIZATIONS=y
# 开启时间片调度
CONFIG_TIMESLICING=y
# 每个线程时间片为 50ms
CONFIG_TIMESLICE_SIZE=50

# 启用动态注册和卸载中断
CONFIG_DYNAMIC_INTERRUPTS=y
# 启用共享中断
CONFIG_SHARED_INTERRUPTS=y
# 每个中断线最大共享中断数
CONFIG_SHARED_IRQ_MAX_NUM_CLIENTS=2
```

## src/main.c
```c
/*
 * @Author: tao wang
 * @Date: 2025-06-24 19:56:07
 * @LastEditors: tao wang
 * @LastEditTime: 2025-07-07 17:54:42
 * @Description: 
 * 简化版 Zephyr 中断 API Demo，
 * @FilePath: /zephyrproject/my-app/src/main.c
 */
#include <zephyr/kernel.h>
#include <zephyr/sys/printk.h>

#define DEMO_IRQ_LINE 20  // 模拟中断号（可选 16 ~ 239 之间的未占用号）

static struct k_work demo_work;


/* 工作项处理函数（线程上下文） */
void demo_work_handler(struct k_work *work)
{
    printk(">>> demo_work_handler!\n");
}

/* 中断服务程序（ISR 上下文） */
void demo_isr1(const void *arg)
{
    ARG_UNUSED(arg);
    printk(">>> ISR 1 triggered (IRQ %d)\n", DEMO_IRQ_LINE);
    k_work_submit(&demo_work);
}


/* 中断服务程序（ISR 上下文） */
void demo_isr2(const void *arg)
{
    ARG_UNUSED(arg);
    printk(">>> ISR 2 triggered (IRQ %d)\n", DEMO_IRQ_LINE);
    k_work_submit(&demo_work);
}

/* 直接中断 */
ISR_DIRECT_DECLARE(direct_isr)
{
    printk(">>> DIRECT ISR triggered (IRQ %d)\n", DEMO_IRQ_LINE);
   /* PM done after servicing interrupt for best latency. This cannot be
   used for zero-latency IRQs because it accesses kernel data. */
   ISR_DIRECT_PM();
   /* Ask the kernel to check if scheduling decision should be made. If the
   ISR is for a zero-latency IRQ then the return value must always be 0. */
   return 1;
}


int main(void)
{
    printk("== Zephyr Software IRQ Demo (No peripheral) ==\n");

#if 0
    IRQ_CONNECT(DEMO_IRQ_LINE, 0, demo_isr, NULL, 0);
#endif

#if 1
    /* 注册动态中断处理程序 */
    irq_connect_dynamic(DEMO_IRQ_LINE, 0, demo_isr1, NULL, 0);
    irq_connect_dynamic(DEMO_IRQ_LINE, 0, demo_isr2, NULL, 0);
#endif

#if 0
    IRQ_DIRECT_CONNECT(DEMO_IRQ_LINE, 0, direct_isr, 0);
#endif

    irq_enable(DEMO_IRQ_LINE);

    printk("Registered dynamic IRQ handler on line %u\n", DEMO_IRQ_LINE);

    k_work_init(&demo_work, demo_work_handler);

    while (1) {
        printk("Triggering IRQ %d from main thread...\n", DEMO_IRQ_LINE);
        /* 手动设置挂起（触发中断） */
        NVIC_SetPendingIRQ(DEMO_IRQ_LINE);  // ARM Cortex-M 方式
        k_sleep(K_SECONDS(2));

    }

    return 0;
}
```

## src/thread_monitor.c
```c
/*
 * @Author: tao wang
 * @Date: 2025-07-04 17:44:55
 * @LastEditors: tao wang
 * @LastEditTime: 2025-07-04 17:55:52
 * @Description: 检测线程状态
 * @FilePath: /zephyrproject/my-app/src/thread_monitor.c
 */
#include <zephyr/kernel.h>
#include <zephyr/sys/printk.h>
#include <string.h>


// 自定义状态宏（避免与 Zephyr 内部冲突）
#ifndef MY_THREAD_DUMMY
#define MY_THREAD_DUMMY      0x01
#define MY_THREAD_PENDING    0x02
#define MY_THREAD_PRESTART   0x04
#define MY_THREAD_DEAD       0x08
#define MY_THREAD_SUSPENDED  0x10
#define MY_THREAD_ABORTING   0x20
#define MY_THREAD_QUEUED     0x40
#define MY_THREAD_STARTED    0x80
#endif

const char *thread_state_to_str(uint8_t state)
{
    if (state == 0) return "READY";

    static char buf[64];
    buf[0] = '\0';

    if (state & MY_THREAD_DEAD) strcat(buf, "DEAD ");
    if (state & MY_THREAD_SUSPENDED) strcat(buf, "SUSPENDED ");
    if (state & MY_THREAD_PENDING) strcat(buf, "PENDING ");
    if (state & MY_THREAD_PRESTART) strcat(buf, "PRESTART ");
    if (state & MY_THREAD_ABORTING) strcat(buf, "ABORTING ");
    if (state & MY_THREAD_DUMMY) strcat(buf, "DUMMY ");
    if (state & MY_THREAD_QUEUED) strcat(buf, "QUEUED ");
    if (state & MY_THREAD_STARTED) strcat(buf, "STARTED ");

    return buf;
}

void thread_callback(const struct k_thread *thread, void *user_data)
{
    const char *name = k_thread_name_get((k_tid_t)thread);
    if (!name)
        name = "<unnamed>";

    int prio = k_thread_priority_get((k_tid_t)thread);
    const char *state_str = thread_state_to_str(thread->base.thread_state);

    printk("Thread: %-12s | Prio: %2d | State: %s\n", name, prio, state_str);

}

void print_all_threads(void)
{
    printk("\n== Thread Monitor ==\n");
    k_thread_foreach(thread_callback, NULL);
}
```

## src/thread_monitor.h
```c
/*
 * @Author: tao wang
 * @Date: 2025-07-04 17:47:19
 * @LastEditors: tao wang
 * @LastEditTime: 2025-07-04 17:49:25
 * @Description: 线程检测头文件
 * @FilePath: /zephyrproject/my-app/src/thread_monitor.h
 */
#ifndef THREAD_MONITOR_H
#define THREAD_MONITOR_H

#ifdef __cplusplus
extern "C" {
#endif

/** 
 * @brief 打印系统中所有线程的信息（名字、优先级、状态、栈剩余空间）
 */
void print_all_threads(void);

#ifdef __cplusplus
}
#endif

#endif /* THREAD_MONITOR_H */
```
